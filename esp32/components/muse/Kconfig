## esp32/components/muse/Kconfig
```kconfig
# Copyright (c) Meta Platforms, Inc. and affiliates.
#
# Licensed under the Apache License, Version 2.0 (the "License");
# you may not use this file except in compliance with the License.
# You may obtain a copy of the License at
#
#     http://www.apache.org/licenses/LICENSE-2.0
#
# Unless required by applicable law or agreed to in writing, software
# distributed under the License is distributed on an "AS IS" BASIS,
# WITHOUT WARRANTIES OR CONDITIONS OF ANY KIND, either express or implied.
# See the License for the specific language governing permissions and
# limitations under the License.

menu "Muse"

    choice MUSE_BOARD
        prompt "Board with the full UI"
        default MUSE_BOARD_NONE
        help
            The UI is the voice companion on boards with a screen: an
            animated avatar, push-to-talk chat, settings, and battery
            handling. It runs beside Home Link, which owns Wi-Fi, BLE
            pairing, credentials and OTA. Pick the board it runs on, or none
            for a Link without a display.

        config MUSE_BOARD_NONE
            bool "None (Home Link without a display)"

        config MUSE_BOARD_WAVESHARE_S3_175C
            bool "Waveshare ESP32-S3-Touch-AMOLED-1.75C"
            depends on IDF_TARGET_ESP32S3

        config MUSE_BOARD_WAVESHARE_S3_175
            bool "Waveshare ESP32-S3-Touch-AMOLED-1.75 (not the 1.75C)"
            depends on IDF_TARGET_ESP32S3

        config MUSE_BOARD_AIPI
            bool "AIPI Lite (ESP32-S3, two buttons, no touch)"
            depends on IDF_TARGET_ESP32S3

        config MUSE_BOARD_ESPRESSIF_BOX_3
            bool "Espressif ESP32-S3-BOX-3 (320x240 touch LCD, speaker and microphones)"
            depends on IDF_TARGET_ESP32S3

        config MUSE_BOARD_WAVESHARE_C6_18
            bool "Waveshare ESP32-C6-Touch-AMOLED-1.8"
            depends on IDF_TARGET_ESP32C6

        config MUSE_BOARD_SENSECAP_WATCHER
            bool "Seeed SenseCAP Watcher (ESP32-S3, round touch LCD, wheel)"
            depends on IDF_TARGET_ESP32S3

        config MUSE_BOARD_M5STACK_CARDPUTER_ADV
            bool "M5Stack Cardputer ADV (ESP32-S3, keyboard, no PSRAM)"
            depends on IDF_TARGET_ESP32S3

        config MUSE_BOARD_M5STACK_STICKS3
            bool "M5Stack StickS3 (ESP32-S3, two buttons, no touch)"
            depends on IDF_TARGET_ESP32S3

        config MUSE_BOARD_M5STACK_STICKC_PLUS2
            bool "M5Stack StickC Plus2 (ESP32, two buttons, no touch)"
            depends on IDF_TARGET_ESP32

        config MUSE_BOARD_M5STACK_STOPWATCH
            bool "M5Stack StopWatch (ESP32-S3, round touch AMOLED)"
            depends on IDF_TARGET_ESP32S3

        config MUSE_BOARD_M5STACK_CORES3
            bool "M5Stack CoreS3 (ESP32-S3, 320x240 touch LCD, speaker and microphones)"
            depends on IDF_TARGET_ESP32S3

        config MUSE_BOARD_M5STACK_CORE2
            bool "M5Stack Core2 v1.0 (ESP32, touch LCD, touch-strip talk)"
            depends on IDF_TARGET_ESP32
        config MUSE_BOARD_FNK0104B
            bool "Freenove FNK0104B (ESP32-S3, 240x320 touch LCD, ES8311 speaker and mic)"
            depends on IDF_TARGET_ESP32S3
        config MUSE_BOARD_GUITION_JC3248W535
            bool "Guition JC3248W535 (ESP32-S3, 3.5\" 320x480 touch LCD, speaker)"
            depends on IDF_TARGET_ESP32S3

        config MUSE_BOARD_WAVESHARE_S3_LCD7
            bool "Waveshare ESP32-S3-Touch-LCD-7 (800x480 touch LCD, no audio)"
            depends on IDF_TARGET_ESP32S3

        config MUSE_BOARD_M5STACK_TAB5
            bool "M5Stack Tab5 (ESP32-P4, 5\" 1280x720 touch LCD, Wi-Fi and BLE on an ESP32-C6)"
            depends on IDF_TARGET_ESP32P4
    endchoice

    config MUSE_ENABLED
        bool
        default y if !MUSE_BOARD_NONE

    # Always defined, unlike the target-dependent board options, so
    # idf_component.yml rules can select each board's managed components.
    config MUSE_BOARD_ID
        string
        default "waveshare_s3_175c" if MUSE_BOARD_WAVESHARE_S3_175C
        default "waveshare_s3_175" if MUSE_BOARD_WAVESHARE_S3_175
        default "aipi" if MUSE_BOARD_AIPI
        default "espressif_box_3" if MUSE_BOARD_ESPRESSIF_BOX_3
        default "waveshare_c6_18" if MUSE_BOARD_WAVESHARE_C6_18
        default "sensecap_watcher" if MUSE_BOARD_SENSECAP_WATCHER
        default "m5stack_sticks3" if MUSE_BOARD_M5STACK_STICKS3
        default "m5stack_stickc_plus2" if MUSE_BOARD_M5STACK_STICKC_PLUS2
        default "m5stack_cardputer_adv" if MUSE_BOARD_M5STACK_CARDPUTER_ADV
        default "m5stack_stopwatch" if MUSE_BOARD_M5STACK_STOPWATCH
        default "m5stack_cores3" if MUSE_BOARD_M5STACK_CORES3
        default "m5stack_core2" if MUSE_BOARD_M5STACK_CORE2
        default "fnk0104b" if MUSE_BOARD_FNK0104B
        default "guition_jc3248w535" if MUSE_BOARD_GUITION_JC3248W535
        default "waveshare_s3_lcd7" if MUSE_BOARD_WAVESHARE_S3_LCD7
        default "m5stack_tab5" if MUSE_BOARD_M5STACK_TAB5
        default "none"

    # The Muse tools' serial port: the console UART behind the board's USB
    # bridge, where the chip's own USB Serial/JTAG isn't wired to a connector
    # (the Watcher's USB-C goes to a CH342) or the chip has none.
    config MUSE_CONSOLE_UART
        bool
        default y if MUSE_BOARD_SENSECAP_WATCHER || MUSE_BOARD_WAVESHARE_S3_LCD7 || !SOC_USB_SERIAL_JTAG_SUPPORTED

    # A board overlay can raise this for a quiet speaker.
    config MUSE_DEFAULT_VOLUME
        int "Speaker volume until one is chosen in settings (percent)"
        range 0 100
        default 70

    config MUSE_ELEVENLABS_API_KEY
        string "ElevenLabs API key for spoken replies"
        depends on MUSE_HATCH
        default ""
        help
            With a key, start_tts sends each reply's text to ElevenLabs'
            streaming text-to-speech and plays the MP3 it returns, captions
            following the speech. The key needs the Text to Speech
            permission. Empty: replies stay text. Like the SDK token, the key
            ships inside the firmware: never commit a generated sdkconfig.

    config MUSE_ELEVENLABS_VOICE_ID
        string "ElevenLabs voice ID"
        depends on MUSE_HATCH
        default "EXAVITQu4vr4xnSDxMaL"
        help
            Any voice in the account's library. The default is the premade
            "Sarah".

    config MUSE_ELEVENLABS_MODEL
        string "ElevenLabs model"
        depends on MUSE_HATCH
        default "eleven_flash_v2_5"
        help
            eleven_flash_v2_5 answers fastest and speaks 32 languages;
            eleven_multilingual_v2 sounds richer but starts later.

    config MUSE_TTS_VOICE
        string "Speech server voice"
        depends on MUSE_HATCH
        default "af_heart"
        help
            The voice asked of a speech server on the home network, set at run
            time with the console command ">tts=URL" (for example Kokoro-FastAPI
            at http://192.168.1.20:8880). A server set there is used before
            ElevenLabs, and needs no key. ">tts.voice=NAME" changes the voice.
            af_heart is one of Kokoro's English voices.

    config MUSE_TTS_MODEL
        string "Speech server model"
        depends on MUSE_HATCH
        default "kokoro"
        help
            The "model" field of the request to the speech server.

    config MUSE_TAB5_ROTATE_270
        bool "M5Stack Tab5: landscape the other way up"
        depends on MUSE_BOARD_M5STACK_TAB5
        default n
        help
            The Tab5 runs its portrait panel landscape, turned 90 degrees.
            Turn this on for 270 degrees instead. The Flip button beside
            Muse swaps it at run time and remembers the choice.

    config MUSE_WATCHER_CAMERA
        bool "SenseCAP Watcher camera capture and live preview"
        depends on MUSE_BOARD_SENSECAP_WATCHER && SPIRAM
        default n
        help
            Enable the camera.capture Home Link command and the wheel
            double-click camera preview. Camera buffers and tasks consume
            memory and preview decoding shares CPU time with voice and Link.
            Leave disabled to build without camera support.

    config MUSE_TAB5_CAMERA
        bool "M5Stack Tab5: camera.capture"
        depends on MUSE_BOARD_M5STACK_TAB5 && CAMERA_SC202CS
        default y
        help
            Answer the camera.capture Home Link command with a 640x352 JPEG
            from the Tab5's SC202CS camera (needs CONFIG_CAMERA_SC202CS, set
            in the Tab5 overlay). The camera starts on the first capture.

    config MUSE_TAB5_CAMERA_ROTATION
        int "M5Stack Tab5: camera rotation, degrees counter-clockwise"
        depends on MUSE_TAB5_CAMERA
        default 0
        help
            Turns each frame upright for the Tab5 held landscape (0, 90, 180
            or 270); Flip adds 180. 0 is upright on a Tab5 v1.3 with the
            keyboard below the screen (checked on hardware).

    config MUSE_CAMERA_CAPTURE
        bool
        default y if MUSE_WATCHER_CAMERA || MUSE_TAB5_CAMERA

    config MUSE_CJK_FONT
        bool "Show Chinese and Japanese in captions"
        depends on MUSE_ENABLED
        default n
        help
            Captions fall back to GNU Unifont's 16x16 bitmaps for CJK
            punctuation, kana, the CJK Unified Ideographs and fullwidth
            forms that the ASCII caption font lacks. Small screens, whose
            captions are two lines of 8 px text, show a reply with CJK in it
            one 16 px line at a time. Takes about 850 KB of flash and no RAM.
            Without it those characters show as boxes. Hangul isn't
            included.

    config MUSE_PIXEL_THEME
        bool "Pixel look for the dock around Muse"
        depends on MUSE_ENABLED
        default y if MUSE_BOARD_M5STACK_TAB5
        default n
        help
            Large screens with a dock (the Tab5) draw it in Muse's own
            pixel-art style: night-sky colours, notched pixel borders and
            pixel fonts (Pixelify Sans for chat and titles, Silkscreen for
            labels, both under the SIL Open Font License). Takes about
            120 KB of flash. Without it the dock uses LVGL's Montserrat.

    config MUSE_CLOCK_TZ
        string "Time zone for the dock's clock (POSIX TZ)"
        depends on MUSE_PIXEL_THEME
        default "UTC0"
        help
            The dock's status strip shows the time once it's set over the
            network (SNTP, from pool.ntp.org). A POSIX TZ string: "UTC0",
            "JST-9" for Japan (UTC+9), "PST8PDT,M3.2.0,M11.1.0"
            for US Pacific. Empty hides the clock.

    config MUSE_EMOJI_FONT
        bool "Show emoji in the dock's chat"
        depends on MUSE_ENABLED
        default y if MUSE_BOARD_M5STACK_TAB5
        default n
        help
            The chat beside Muse on large screens (the Tab5's dock) falls
            back to Google's monochrome Noto Emoji at 16 px for the
            emoticons block and about 125 other common emoji, and offers a
            picker of them next to Send. Single-codepoint emoji only:
            variation selectors and skin tones are dropped, and a ZWJ
            sequence shows as its parts. Takes about 30 KB of flash and no
            RAM. Without it emoji show as boxes.

    config MUSE_JC3248W535_MIC_GPIO
        int "JC3248W535: GPIO for an external I2S mic's data (SD) line"
        depends on MUSE_BOARD_GUITION_JC3248W535
        range -1 48
        default -1
        help
            The board has a speaker amp but no microphone. Wire an I2S MEMS
            mic such as an INMP441 to the speaker's clocks (SCK to GPIO42, WS
            to GPIO2), L/R to GND, power to 3.3 V, and its SD line to a free
            GPIO, and set that GPIO here. -1 leaves push-to-talk recording
            silence.

    config MUSE_HATCH
        bool "Muse's own voice session"
        depends on MUSE_ENABLED
        default y if SPIRAM
        default n
        help
            Push-to-talk turns go over a voice session of Muse's own, to the
            VM Home Link is paired with or one set up on the device with a
            device token. Replies are text, shown as captions; start_tts in
            muse_chat_session.cpp is where a TTS API of your own can speak
            them. Needs PSRAM. Without it, voice notes go over Home Link's own
            session to its paired VM and replies are shown as text.

endmenu
```
